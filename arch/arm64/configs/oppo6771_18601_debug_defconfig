## arch/arm64/configs/oppo6771_18601_debug_defconfig
```kconfig
CONFIG_CROSS_COMPILE="aarch64-linux-android-"
# CONFIG_LOCALVERSION_AUTO is not set
# CONFIG_USELIB is not set
CONFIG_SCHED_WALT=y
CONFIG_LOG_BUF_SHIFT=19
CONFIG_CGROUP_DEBUG=y
CONFIG_CPUSETS=y
CONFIG_CGROUP_SCHEDTUNE=y
CONFIG_SCHED_TUNE=y
#ifdef VENDOR_EDIT
#Xuefeng.Peng@PSW.AD.Storage.1596362, 2018/12/07, Add for FBE HIE feature open
CONFIG_HIE=y
CONFIG_HIE_DEBUG=y
CONFIG_FS_ENCRYPTION=y
#endif/*VENDOR_EDIT*/
# CONFIG_RD_BZIP2 is not set
# CONFIG_RD_LZMA is not set
# CONFIG_RD_XZ is not set
# CONFIG_RD_LZO is not set
# CONFIG_RD_LZ4 is not set
CONFIG_SYSCTL_SYSCALL=y
CONFIG_CC_STACKPROTECTOR_STRONG=y
CONFIG_MODULE_SRCVERSION_ALL=y
# CONFIG_BLK_DEV_BSG is not set
CONFIG_MACH_MT6771=y
CONFIG_SCHED_MC=y
CONFIG_NR_CPUS=8
CONFIG_PREEMPT=y
# CONFIG_BOUNCE is not set
CONFIG_CMA_AREAS=1
CONFIG_ZSMALLOC=y
CONFIG_RANDOMIZE_BASE=y
CONFIG_CMDLINE="console=tty0 console=ttyMT3,921600n1 root=/dev/ram vmalloc=496M slub_max_order=0 slub_debug=O "
# CONFIG_EFI is not set
CONFIG_BUILD_ARM64_APPENDED_DTB_IMAGE=y
CONFIG_BUILD_ARM64_APPENDED_DTB_IMAGE_NAMES="mediatek/mt6771"
# CONFIG_BUILD_ARM64_DTB_OVERLAY_IMAGE_NAMES="mediatek/evb6771_64_emmc mediatek/oppo6771_18601 mediatek/oppo6771_18601"
CONFIG_BUILD_ARM64_DTB_OVERLAY_IMAGE_NAMES="mediatek/oppo6771_18601"
# CONFIG_CORE_DUMP_DEFAULT_ELF_HEADERS is not set
CONFIG_COMPAT=y
CONFIG_PM_AUTOSLEEP=y
CONFIG_WQ_POWER_EFFICIENT_DEFAULT=y
CONFIG_CPU_FREQ=y
CONFIG_CPU_FREQ_STAT_DETAILS=y
CONFIG_CPU_FREQ_DEFAULT_GOV_INTERACTIVE=y
CONFIG_CPU_FREQ_GOV_PERFORMANCE=y
CONFIG_CPU_FREQ_GOV_POWERSAVE=y
CONFIG_CPU_FREQ_GOV_USERSPACE=y
CONFIG_CPU_FREQ_GOV_ONDEMAND=y
CONFIG_XFRM_MIGRATE=y
CONFIG_IP_PNP=y
CONFIG_IP_PNP_DHCP=y
CONFIG_IP_PNP_BOOTP=y
CONFIG_NET_IPIP=y
CONFIG_IP_MROUTE=y
CONFIG_IP_MROUTE_MULTIPLE_TABLES=y
CONFIG_IP_PIMSM_V1=y
CONFIG_IP_PIMSM_V2=y
CONFIG_SYN_COOKIES=y
CONFIG_INET_AH=y
CONFIG_INET_IPCOMP=y
# CONFIG_INET_LRO is not set
CONFIG_INET6_AH=y
CONFIG_INET6_XFRM_MODE_ROUTEOPTIMIZATION=y
CONFIG_IPV6_SIT_6RD=y
CONFIG_IPV6_SUBTREES=y
CONFIG_IPV6_MROUTE=y
CONFIG_IPV6_PIMSM_V2=y
CONFIG_BRIDGE_NETFILTER=y
CONFIG_NETFILTER_XT_MATCH_CONNBYTES=y
CONFIG_NETFILTER_XT_MATCH_MULTIPORT=y
CONFIG_NETFILTER_XT_MATCH_PHYSDEV=y
CONFIG_NETFILTER_XT_MATCH_QUOTA2_LOG=y
CONFIG_NETFILTER_XT_MATCH_REALM=y
CONFIG_NETFILTER_XT_MATCH_RECENT=y
CONFIG_NETFILTER_XT_MATCH_TCPMSS=y
CONFIG_IP_NF_MATCH_AH=y
CONFIG_IP6_NF_MATCH_FRAG=y
CONFIG_IP6_NF_MATCH_IPV6HEADER=y
CONFIG_IP6_NF_TARGET_HL=y
CONFIG_BRIDGE=y
CONFIG_VLAN_8021Q=y
CONFIG_NET_SCH_INGRESS=y
CONFIG_NET_CLS_FW=y
CONFIG_CLS_U32_PERF=y
CONFIG_CLS_U32_MARK=y
CONFIG_NET_CLS_FLOW=y
CONFIG_NET_ACT_POLICE=y
CONFIG_NET_ACT_MIRRED=y
CONFIG_NET_ACT_IPT=y
CONFIG_NET_CLS_IND=y
CONFIG_CFG80211=y
CONFIG_NL80211_TESTMODE=y
CONFIG_CFG80211_DEVELOPER_WARNINGS=y
# CONFIG_CFG80211_DEFAULT_PS is not set
CONFIG_CFG80211_DEBUGFS=y
CONFIG_CFG80211_INTERNAL_REGDB=y
CONFIG_MTK_NET_LOGGING=y
CONFIG_ZRAM=y
CONFIG_ZRAM_LZ4_COMPRESS=y
CONFIG_BLK_DEV_LOOP=y
CONFIG_MEDIATEK_SOLUTION=y
CONFIG_MTK_PLATFORM="mt6771"
CONFIG_ARCH_MTK_PROJECT="oppo6771_18601"
CONFIG_MTK_PSCI=y
CONFIG_MTK_ENG_BUILD=y
#ifdef ODM_HQ_EDIT
#gongpeicai@ODM_HQ.Android.Partition, 2018/10/15 modify for open odm partion.
CONFIG_TARGET_COPY_OUT_ODM=y
#endif ODM_HQ_EDIT
CONFIG_MTK_SHARED_SDCARD=y
CONFIG_MTK_GPT_SCHEME_SUPPORT=y
CONFIG_MTK_MEMORY_LOWPOWER=y
CONFIG_MTK_PASR=y
CONFIG_MTK_UNIFY_POWER=y
CONFIG_MTK_CM_MGR=y
CONFIG_MTK_FREQ_HOPPING=y
CONFIG_MTK_PMIC_NEW_ARCH=y
CONFIG_MTK_PMIC_COMMON=y
CONFIG_MTK_PMIC_CHIP_MT6358=y
CONFIG_MTK_AUXADC_INTF=y
CONFIG_MTK_EXTERNAL_CHARGER_TYPE_DETECT=y
CONFIG_MFD_MT6370_PMU=y
CONFIG_MT6370_PMU_CHARGER=y
CONFIG_MT6370_PMU_FLED=y
CONFIG_MT6370_PMU_BLED=y
CONFIG_MT6370_PMU_LDO=y
CONFIG_MT6370_PMU_DSV=y
# CONFIG_MTK_PMIC is not set
CONFIG_MTK_THERMAL_PA_VIA_ATCMD=y
CONFIG_CUSTOM_KERNEL_IMGSENSOR="s5k3l6_main_qt_mipi_raw ov13855_main_ly_mipi_raw s5k3l6_main_ts_mipi_raw s5k3l6_sub_qt_mipi_raw ov13855_sub_ly_mipi_raw s5k3l6_sub_ly_mipi_raw gc2375_jk_mipi_raw sp2509_hl_mipi_raw gc2375_bl_mipi_raw"
CONFIG_CUSTOM_KERNEL_CAM_CAL_DRV="BRCB032GWZ_3 GT24c32a cat24c16"
CONFIG_MTK_CAMERA_ISP_RSC_SUPPORT=y
CONFIG_MTK_CAMERA_ISP_DPE_SUPPORT=y
CONFIG_MTK_CAMERA_ISP_TSF_SUPPORT=y
CONFIG_MTK_CAMERA_ISP_FD_SUPPORT=y
CONFIG_MTK_CAMERA_ISP_WPE_SUPPORT=y
CONFIG_MTK_CAMERA_ISP_OWE_SUPPORT=y
CONFIG_MTK_CAMERA_ISP_MFB_SUPPORT=y
CONFIG_MTK_CAM_CAL=y
CONFIG_MTK_CMDQ=y
CONFIG_MTK_FLASHLIGHT=y
#ifndef VENDOR_EDIT
#Caohua.Lin 2018/07/23 modify
#CONFIG_MTK_FLASHLIGHT_MT6370=y
CONFIG_MTK_FLASHLIGHT_PT=y
CONFIG_MTK_FLASHLIGHT_PT_STRICT=y
#else
CONFIG_MTK_FLASHLIGHT_LM3642=y
CONFIG_MTK_FLASHLIGHT_AW3642=y
CONFIG_MTK_FLASHLIGHT_MP3331=y
#endif /* VENDOR_EDIT */
#ifdef ODM_HQ_EDIT
#shuchengsong@ODM.Multimedia.Camera  2018/10/09 Modify for 18601 project Flashlight bringup
CONFIG_MTK_FLASHLIGHT_MT6370=y
#endif #ODM_HQ_EDIT
CONFIG_MTK_FLASHLIGHT_DLPT=y
CONFIG_RT_FLASHLIGHT=y
CONFIG_MTK_CCU=y
CONFIG_MTK_GPU_SUPPORT=y
CONFIG_MTK_GPU_VERSION="mali bifrost r14p0"
CONFIG_MTK_GPU_COMMON_DVFS_SUPPORT=y
CONFIG_MTK_IMGSENSOR=y
CONFIG_SPECIFY_IMGSENSOR=y
CONFIG_IMGSENSOR_MAIN="imx519_mipi_raw s5kgm1sp_mipi_raw"
CONFIG_IMGSENSOR_MAIN2="s5k5e9_mipi_raw gc5035_mipi_raw"
CONFIG_IMGSENSOR_SUB="imx476_mipi_raw s5k3p9sp_mipi_raw"
CONFIG_MTK_JPEG=y
CONFIG_MTK_LCM=y
CONFIG_MTK_ROUND_CORNER_SUPPORT=y
#ifndef ODM_HQ_EDIT
#liyan@ODM.Multimedia.LCD  2018/10/03 add for LCD bring up
#CONFIG_CUSTOM_KERNEL_LCM="nt35695_fhd_dsi_vdo_truly_rt5081 nt35695B_fhd_dsi_vdo_auo_rt5081"
#else #ODM_HQ_EDIT
CONFIG_CUSTOM_KERNEL_LCM="nt36525_hd_dsi_vdo_dj_boe_zal1810 ili9881_hd_dsi_vdo_txd_csot_zal1810 ili9881_hd_dsi_vdo_dj_boe_zal1810"
CONFIG_SET_LCD_BIAS_ODM_HQ=y
# CONFIG_EXT_LCD_BIAS_ODM_HQ is not set
CONFIG_LCM_HEIGHT="1520"
CONFIG_LCM_WIDTH="720"
#endif #ODM_HQ_EDIT
CONFIG_MTK_LENS=y
CONFIG_MTK_SYNC=y
CONFIG_MTK_VIDEOCODEC_DRIVER=y
CONFIG_MTK_FB=y
CONFIG_MTK_LCM_PHYSICAL_ROTATION="0"
CONFIG_MTK_AAL_SUPPORT=y
CONFIG_MTK_VPU_SUPPORT=y
CONFIG_MTK_DYNAMIC_FPS_FRAMEWORK_SUPPORT=y
CONFIG_MTK_SENSOR_SUPPORT=y
CONFIG_MTK_SENSORS_1_0=y
CONFIG_CUSTOM_KERNEL_ACCELEROMETER=y
CONFIG_MTK_ACCELHUB=y
CONFIG_CUSTOM_KERNEL_ALSPS=y
CONFIG_MTK_ALSPSHUB=y
CONFIG_CUSTOM_KERNEL_GYROSCOPE=y
CONFIG_MTK_GYROHUB=y
CONFIG_CUSTOM_KERNEL_MAGNETOMETER=y
CONFIG_MTK_MAGHUB=y
CONFIG_MTK_HWMON=y
#ifdef ODM_HQ_EDIT
# zuoqiquan@ODM_HQ.Sensors.SCP.BSP, 2018/10/09,have no barometer
# CONFIG_CUSTOM_KERNEL_BAROMETER is not set
# CONFIG_MTK_BAROHUB is not set
#else
# CONFIG_CUSTOM_KERNEL_BAROMETER=y
# CONFIG_MTK_BAROHUB=y
#endif #ODM_HQ_EDIT
#ifdef ODM_HQ_EDIT
#chenfengjie@ODM.Multimedia.CAMERA, 2018/10/13, add for hardware info.
CONFIG_HARDWARE_INFO_HQ=y
#else
#CONFIG_HARDWARE_INFO_HQ is not set
#endif #ODM_HQ_EDIT
CONFIG_CUSTOM_KERNEL_SENSOR_FUSION=y
CONFIG_CUSTOM_KERNEL_GRV_SENSOR=y
CONFIG_CUSTOM_KERNEL_GMRV_SENSOR=y
CONFIG_CUSTOM_KERNEL_RV_SENSOR=y
CONFIG_CUSTOM_KERNEL_LINEARACCEL_SENSOR=y
CONFIG_CUSTOM_KERNEL_GRAVITY_SENSOR=y
CONFIG_CUSTOM_KERNEL_UNCALI_ACC_SENSOR=y
CONFIG_CUSTOM_KERNEL_UNCALI_GYRO_SENSOR=y
CONFIG_CUSTOM_KERNEL_UNCALI_MAG_SENSOR=y
CONFIG_MTK_UNCALI_MAGHUB=y
CONFIG_MTK_UNCALI_GYROHUB=y
CONFIG_MTK_GAMEROTVECHUB=y
CONFIG_MTK_ROTATVECHUB=y
CONFIG_MTK_GMAGROTVECHUB=y
CONFIG_MTK_GRAVITYHUB=y
CONFIG_MTK_LINEARACCHUB=y
CONFIG_MTK_ORIENTHUB=y
CONFIG_MTK_UNCALI_ACCHUB=y
CONFIG_CUSTOM_KERNEL_STEP_COUNTER=y
CONFIG_MTK_STEPSIGNHUB=y
CONFIG_CUSTOM_KERNEL_SITUATION=y
CONFIG_MTK_STATHUB=y
# ifdef ODM_HQ_EDIT
# zuoqiquan@ODM_HQ.Sensors.SCP.BSP, 2018/12/28,close function for save ram
# CONFIG_MTK_INPKHUB is not set
# CONFIG_MTK_WAKEHUB is not set
# CONFIG_MTK_GLGHUB is not set
# CONFIG_MTK_FLAT_HUB is not set
# endif
CONFIG_MTK_DEVICE_ORIENTATION_HUB=y
CONFIG_MTK_MOTION_DETECT_HUB=y
CONFIG_MTK_TILTDETECTHUB=y
CONFIG_CUSTOM_KERNEL_SENSORHUB=y
CONFIG_MTK_BTIF=y
CONFIG_MTK_MD1_SUPPORT=12
CONFIG_MTK_C2K_LTE_MODE=2
CONFIG_MTK_COMBO=y
CONFIG_MTK_COMBO_CHIP_CONSYS_6771=y
CONFIG_MTK_COMBO_BT=y
CONFIG_MTK_COMBO_GPS=y
CONFIG_MTK_COMBO_WIFI=y
CONFIG_MTK_WAPI_SUPPORT=y
CONFIG_MTK_DHCPV6C_WIFI=y
CONFIG_MTK_GPS_SUPPORT=y
CONFIG_MTK_GPS_EMI=y
CONFIG_MTK_FMRADIO=y
CONFIG_MTK_FM_CHIP="MT6631_FM"
CONFIG_MTK_ECCCI_DRIVER=y
CONFIG_MTK_ECCCI_C2K=y
CONFIG_MTK_ACCDET=y
CONFIG_ACCDET_EINT_IRQ=y
CONFIG_ACCDET_SUPPORT_EINT0=y
#CONFIG_MT6771_QUERY_PCB_ID is not set
CONFIG_MTK_DEBUG_LATCH=y
CONFIG_MTK_DEVAPC_DRIVER=y
CONFIG_MTK_DRAMC=y
CONFIG_MTK_DRAMC_PASR=y
CONFIG_MTK_EMI=y
# CONFIG_MTK_EMI_BWL is not set
# CONFIG_MTK_EMI_MBW is not set
# CONFIG_MTK_EMI_MPU is not set
# CONFIG_MTK_GPIO is not set
CONFIG_MTK_LEDS=y
CONFIG_USB_MU3D_DRV=y
CONFIG_MTK_SIB_USB_SWITCH=y
CONFIG_MU3_PHY=y
CONFIG_U3_PHY_AHB_SUPPORT=y
CONFIG_PROJECT_PHY=y
CONFIG_U3_PHY_SMT_LOOP_BACK_SUPPORT=y
CONFIG_MTK_PWM=y
CONFIG_MTK_RTC=y
CONFIG_MTK_TINYSYS_SCP_SUPPORT=y
CONFIG_MTK_TINYSYS_SSPM_SUPPORT=y
CONFIG_MTK_SMI_EXT=y
#ifndef ODM_HQ_EDIT
#liguangxian@ODM.Bsp.Charger  2018/10/03 add for charger bring up
# CONFIG_TCPC_CLASS=y
# CONFIG_USB_POWER_DELIVERY=y
# CONFIG_TCPC_MT6370=y
# CONFIG_USB_C_SWITCH_U3_MUX=y
#else #ODM_HQ_EDIT
# CONFIG_TCPC_CLASS is not set
# CONFIG_USB_POWER_DELIVERY is not set
# CONFIG_TCPC_MT6370 is not set
# CONFIG_USB_C_SWITCH_U3_MUX is not set
#endif #ODM_HQ_EDIT
#ifdef ODM_HQ_EDIT
#hanwenchao@ODM.Bsp.OTG  2018/10/09 add for otg bring up
CONFIG_USB_MTK_IDDIG=y
#endif #ODM_HQ_EDIT
CONFIG_MTK_VIBRATOR=y
CONFIG_USB_MTK_DUALMODE=y
#ifdef VENDOR_EDIT
#Qiao.Hu@BSP.BaseDrv.CHG.Basic, 2017/11/19, Add for otg
CONFIG_USB_MTK_IDDIG=y
#endif
CONFIG_MTK_FPSGO=y
CONFIG_MTK_FPSGO_FBT_GAME=y
CONFIG_MTK_FPSGO_FBT_UX=y
CONFIG_MTK_FPSGO_FSTB=y
CONFIG_MTK_MEMCFG=y
CONFIG_MTK_AEE_FEATURE=y
CONFIG_MTK_AEE_MRDUMP=y
CONFIG_MTK_CHIP=y
CONFIG_MTK_DRAM_LOG_STORE=y
CONFIG_MTK_DRAM_LOG_STORE_ADDR=0x0011DF00
CONFIG_MTK_DRAM_LOG_STORE_SIZE=0x100
CONFIG_MTPROF=y
CONFIG_MTK_SCHED_MONITOR=y
CONFIG_PREEMPT_MONITOR=y
CONFIG_MTK_WQ_DEBUG=y
CONFIG_MTK_RCU_MONITOR=y
CONFIG_MTK_CPU_CTRL_CFP=y
CONFIG_MTK_RAM_CONSOLE=y
CONFIG_MTK_RAM_CONSOLE_USING_SRAM=y
CONFIG_MTK_RAM_CONSOLE_SIZE=0x800
CONFIG_MTK_RAM_CONSOLE_ADDR=0x0011D000
CONFIG_MTK_RAM_CONSOLE_DRAM_SIZE=0x10000
CONFIG_MTK_RAM_CONSOLE_DRAM_ADDR=0x54400000
CONFIG_MTK_CPU_AFFINITY=y
CONFIG_MTK_USER_SPACE_GLOBAL_CPUSET=y
CONFIG_MTK_IDLE_BALANCE_ENHANCEMENT=y
CONFIG_MTK_SCHED_INTEROP=y
CONFIG_MTK_SCHED_TRACE=y
CONFIG_MTK_RT_THROTTLE_MON=y
CONFIG_MTK_CPU_TOPOLOGY=y
CONFIG_MTK_SCHED_RQAVG_KS=y
CONFIG_MTK_SCHED_RQAVG_US=y
CONFIG_MTK_SCHED_CPULOAD=y
CONFIG_MTK_SCHED_EAS_PLUS=y
CONFIG_MTK_SCHED_EAS_POWER_SUPPORT=y
CONFIG_MTK_SCHED_VIP_TASKS=y
CONFIG_CPU_FREQ_GOV_SCHEDPLUS=y
CONFIG_SCHED_HMP=y
CONFIG_SCHED_HMP_PRIO_FILTER=y
CONFIG_HMP_TRACER=y
CONFIG_SCHED_HMP_PLUS=y
CONFIG_MTK_SCHED_BOOST=y
CONFIG_MTK_SYSENV=y
#ifdef VENDOR_EDIT
#//Fei.Mo@PSW.BSP.Sensor, 2017-12-22, Remove VOW,we don't need this function
#CONFIG_MTK_VOW_SUPPORT=y
#endif
CONFIG_MTK_ACAO_SUPPORT=y
CONFIG_MTK_TIMER_TIMESYNC=y
CONFIG_MTK_IO_BOOST=y
CONFIG_ANDROID_DEFAULT_SETTING=y
CONFIG_SCSI=y
CONFIG_BLK_DEV_SD=y
CONFIG_SCSI_SCAN_ASYNC=y
# CONFIG_SCSI_LOWLEVEL is not set
CONFIG_MD=y
CONFIG_BLK_DEV_DM=y
CONFIG_DM_DEBUG=y
CONFIG_DM_CRYPT=y
CONFIG_DM_UEVENT=y
CONFIG_DM_VERITY_FEC=y
CONFIG_MTK_HW_FDE=y
CONFIG_IFB=y
# CONFIG_ETHERNET is not set
CONFIG_PPP_FILTER=y
CONFIG_PPP_MULTILINK=y
CONFIG_PPPOE=y
# ifdef VENDOR_EDIT
# yongyao.song@SWDP.Network.Data, 2015/12/24, add for vpn support
CONFIG_PPPOL2TP=y
# endif
CONFIG_PPP_ASYNC=y
CONFIG_PPP_SYNC_TTY=y
# CONFIG_INPUT_MOUSEDEV is not set
CONFIG_INPUT_EVDEV=y
CONFIG_KEYBOARD_MTK=y
#ifdef ODM_HQ_EDIT
#hanwenchao@ODM.Bsp.Boot 2018/10/16 add for Volume up+Power key Reboot
# CONFIG_ONEKEY_REBOOT_NORMAL_MODE is not set
# CONFIG_ONEKEY_REBOOT_OTHER_MODE is not set
CONFIG_KPD_PMIC_LPRST_TD=0
CONFIG_TWOKEY_REBOOT_OTHER_MODE=y
CONFIG_TWOKEY_REBOOT_NORMAL_MODE=y
CONFIG_TWOKEY_REBOOT_OTHER_MODE=y
#endif #ODM_HQ_EDIT
CONFIG_KPD_PWRKEY_USE_PMIC=y
CONFIG_MTK_MRDUMP_KEY=y
# CONFIG_KEYBOARD_ATKBD is not set
# CONFIG_INPUT_MOUSE is not set
CONFIG_INPUT_TOUCHSCREEN=y
CONFIG_TOUCHSCREEN_MTK=y
# ifndef VENDOR_EDIT
# Mingqiang.Guo@PSW.BSP.TP.Funtion, delete for TP Driver S4310
# CONFIG_TOUCHSCREEN_MTK_GT1151=y
# CONFIG_GT1151_FIRMWARE="firmware2"
# CONFIG_GT1151_CONFIG="config17"
# endif /* VENDOR_EDIT */

#ifdef ODM_HQ_EDIT
#Qiuyu.Fan@ODM_HQ.MM.Tp, 2018/10/03, add tp driver
CONFIG_TOUCHPANEL_HQ=y
CONFIG_TOUCHSCREEN_ILI9881H=y
CONFIG_TOUCHSCREEN_MTK_NT36xxx_HOSTDL_SPI=y
CONFIG_TOUCHSCREEN_MTK_GT1151=n
#endif
#CONFIG_GT1151_FIRMWARE="firmware2"
#CONFIG_GT1151_CONFIG="config17"
CONFIG_GTP_DRIVER_SEND_CFG=y
CONFIG_GTP_CUSTOM_CFG=y
CONFIG_GTP_AUTO_UPDATE=y
CONFIG_GTP_HEADER_FW_UPDATE=y
CONFIG_GTP_CREATE_WR_NODE=y
CONFIG_GTP_POWER_CTRL_SLEEP=y
CONFIG_INPUT_MISC=y
CONFIG_INPUT_UINPUT=y
# CONFIG_SERIO is not set
# CONFIG_VT is not set
CONFIG_LEGACY_PTY_COUNT=16
# CONFIG_DEVMEM is not set
# CONFIG_DEVKMEM is not set
CONFIG_SERIAL_8250=y
CONFIG_SERIAL_8250_CONSOLE=y
CONFIG_SERIAL_8250_NR_UARTS=3
CONFIG_SERIAL_8250_RUNTIME_UARTS=3
CONFIG_SERIAL_8250_MT6577=y
# CONFIG_HW_RANDOM is not set
CONFIG_SPI=y
CONFIG_SPI_MT65XX=y
# ifndef VENDOR_EDIT
# Fuchun.Liao@BSP.CHG.Basic 2017/11/09 modify to use bq24190 charger
# CONFIG_CHARGER_RT9465=y
# endif /* VENDOR_EDIT */
#ifndef ODM_HQ_EDIT
#liguangxian@ODM.Bsp.Charger  2018/10/03 add for charger bring up
# CONFIG_CHARGER_RT9465=y
#else #ODM_HQ_EDIT
# CONFIG_CHARGER_RT9465 is not set
#endif #ODM_HQ_EDIT
CONFIG_MTK_SMART_BATTERY=y
CONFIG_MTK_SWCHR_SUPPORT=y
CONFIG_MTK_KERNEL_POWER_OFF_CHARGING=y
CONFIG_MTK_GAUGE_VERSION=30
#ifndef ODM_HQ_EDIT
#liguangxian@ODM.Bsp.Charger  2018/10/03 add for charger bring up
# CONFIG_MTK_PUMP_EXPRESS_PLUS_SUPPORT=y
# CONFIG_MTK_PUMP_EXPRESS_PLUS_20_SUPPORT=y
# CONFIG_MTK_DUAL_CHARGER_SUPPORT=y
#else #ODM_HQ_EDIT
# CONFIG_MTK_PUMP_EXPRESS_PLUS_SUPPORT is not set
# CONFIG_MTK_PUMP_EXPRESS_PLUS_20_SUPPORT is not set
# CONFIG_MTK_DUAL_CHARGER_SUPPORT is not set
#endif #ODM_HQ_EDIT
# CONFIG_HWMON is not set
CONFIG_THERMAL=y
CONFIG_THERMAL_DEFAULT_GOV_BACKWARD_COMPATIBLE=y
CONFIG_WATCHDOG=y
CONFIG_MTK_WATCHDOG_COMMON=y
CONFIG_MTK_WATCHDOG_COMMON_V2=y
CONFIG_REGULATOR=y
CONFIG_FB=y
CONFIG_FB_MODE_HELPERS=y
CONFIG_FB_TILEBLITTING=y
CONFIG_LOGO=y
CONFIG_SOUND=y
CONFIG_SND=y
CONFIG_SND_SEQUENCER=y
CONFIG_SND_SEQ_DUMMY=y
CONFIG_SND_SEQUENCER_OSS=y
CONFIG_SND_HRTIMER=y
CONFIG_SND_DYNAMIC_MINORS=y
CONFIG_SND_VERBOSE_PRINTK=y
CONFIG_SND_DEBUG=y
CONFIG_SND_DEBUG_VERBOSE=y
CONFIG_SND_PCM_XRUN_DEBUG=y
# CONFIG_SND_SPI is not set
CONFIG_SND_USB_AUDIO=y
CONFIG_MTK_UAC_POWER_SAVING=y
CONFIG_SND_SOC=y
CONFIG_MTK_SND_SOC_CODEC="mt6358"
CONFIG_SND_SOC_MTK_BTCVSD=y
CONFIG_MTK_SND_SOC_NEW_ARCH=y
#ifndef VENDOR_EDIT
# Xiaojun.Lv@PSW.MM.AudioDriver.HAL, 2018/7/13, Remove for TFA9890 ALSA driver
#CONFIG_SND_SOC_RT5509=y
#endif /* VENDOR_EDIT */
CONFIG_SOUND_PRIME=y
CONFIG_HIDRAW=y
CONFIG_UHID=y
CONFIG_HID_A4TECH=y
CONFIG_HID_APPLE=y
CONFIG_HID_BELKIN=y
CONFIG_HID_CHERRY=y
CONFIG_HID_CHICONY=y
CONFIG_HID_CYPRESS=y
CONFIG_HID_DRAGONRISE=y
CONFIG_HID_EZKEY=y
CONFIG_HID_KYE=y
CONFIG_HID_GYRATION=y
CONFIG_HID_TWINHAN=y
CONFIG_HID_KENSINGTON=y
CONFIG_HID_LOGITECH=y
CONFIG_HID_MAGICMOUSE=y
CONFIG_HID_MICROSOFT=y
CONFIG_HID_MONTEREY=y
CONFIG_HID_PANTHERLORD=y
CONFIG_HID_PETALYNX=y
CONFIG_HID_SAMSUNG=y
CONFIG_HID_SUNPLUS=y
CONFIG_HID_GREENASIA=y
CONFIG_HID_SMARTJOYPLUS=y
CONFIG_HID_TOPSEED=y
CONFIG_HID_THRUSTMASTER=y
CONFIG_HID_ZEROPLUS=y
CONFIG_USB=y
CONFIG_USB_XHCI_HCD=y
CONFIG_USB_XHCI_MTK=y
CONFIG_USB_STORAGE=y
CONFIG_USB_STORAGE_DATAFAB=y
CONFIG_USB_STORAGE_FREECOM=y
CONFIG_USB_STORAGE_ISD200=y
CONFIG_USB_STORAGE_USBAT=y
CONFIG_USB_STORAGE_SDDR09=y
CONFIG_USB_STORAGE_SDDR55=y
CONFIG_USB_STORAGE_JUMPSHOT=y
CONFIG_USB_STORAGE_ALAUDA=y
CONFIG_USB_STORAGE_ONETOUCH=y
CONFIG_USB_STORAGE_KARMA=y
CONFIG_USB_STORAGE_CYPRESS_ATACB=y
CONFIG_USB_TRANCEVIBRATOR=y
CONFIG_NOP_USB_XCEIV=y
CONFIG_DUAL_ROLE_USB_INTF=y
CONFIG_USB_GADGET_VBUS_DRAW=500
CONFIG_USB_CONFIGFS=y
CONFIG_USB_CONFIGFS_SERIAL=y
CONFIG_USB_CONFIGFS_ACM=y
CONFIG_USB_CONFIGFS_RNDIS=y
CONFIG_USB_CONFIGFS_MASS_STORAGE=y
CONFIG_USB_CONFIGFS_F_MTP=y
CONFIG_USB_CONFIGFS_F_PTP=y
CONFIG_USB_CONFIGFS_F_HID=y
CONFIG_MMC=y
CONFIG_MMC_BLOCK_MINORS=32
CONFIG_MMC_MTK_PRO=y
CONFIG_MTK_EMMC_SUPPORT=y
CONFIG_MTK_EMMC_CACHE=y
CONFIG_MTK_EMMC_SUPPORT_OTP=y
CONFIG_MTK_EMMC_CQ_SUPPORT=y
CONFIG_NEW_LEDS=y
CONFIG_LEDS_CLASS=y
CONFIG_LEDS_TRIGGERS=y
CONFIG_LEDS_TRIGGER_TIMER=y
CONFIG_SWITCH=y
# CONFIG_RTC_SYSTOHC is not set
CONFIG_DMADEVICES=y
CONFIG_DMA_MTK_UART=y
CONFIG_ANDROID_LOW_MEMORY_KILLER=y
CONFIG_ANDROID_INTF_ALARM_DEV=y
CONFIG_SW_SYNC=y
CONFIG_SW_SYNC_USER=y
CONFIG_ION=y
CONFIG_MTK_ION=y
CONFIG_NANOHUB=y
CONFIG_NANOHUB_MTK_IPI=y
CONFIG_ARM64_ERRATUM_858921=y
CONFIG_PM_DEVFREQ=y
CONFIG_MTK_QOS_SUPPORT=y
CONFIG_IIO=y
CONFIG_EXT4_FS=y
CONFIG_EXT4_FS_SECURITY=y
CONFIG_EXT4_ENCRYPTION=y
CONFIG_EXT4_DEBUG=y
CONFIG_QUOTA=y
CONFIG_QUOTA_NETLINK_INTERFACE=y
CONFIG_QFMT_V2=y
CONFIG_FUSE_FS=y
CONFIG_ISO9660_FS=y
CONFIG_JOLIET=y
CONFIG_ZISOFS=y
CONFIG_MSDOS_FS=y
CONFIG_VFAT_FS=y
CONFIG_TMPFS=y
CONFIG_SDCARD_FS=y
CONFIG_PSTORE=y
CONFIG_PSTORE_CONSOLE=y
CONFIG_PSTORE_PMSG=y
CONFIG_PSTORE_RAM=y
CONFIG_PSTORE_CONSOLE_SIZE=0x40000
CONFIG_PSTORE_PMSG_SIZE=0x10000
CONFIG_PSTORE_MEM_ADDR=0x54410000
CONFIG_PSTORE_MEM_SIZE=0xe0000
# CONFIG_NETWORK_FILESYSTEMS is not set
CONFIG_NLS_CODEPAGE_437=y
CONFIG_NLS_CODEPAGE_950=y
CONFIG_NLS_ASCII=y
CONFIG_NLS_ISO8859_1=y
CONFIG_NLS_UTF8=y
CONFIG_PRINTK_TIME=y
CONFIG_DYNAMIC_DEBUG=y
CONFIG_DEBUG_INFO=y
CONFIG_FRAME_WARN=2800
CONFIG_PAGE_OWNER=y
CONFIG_PAGE_OWNER_SLIM=y
CONFIG_DEBUG_SECTION_MISMATCH=y
CONFIG_DEBUG_PAGEALLOC=y
CONFIG_DEBUG_OBJECTS=y
CONFIG_DEBUG_OBJECTS_TIMERS=y
CONFIG_SLUB_DEBUG_ON=y
CONFIG_DEBUG_KMEMLEAK=y
CONFIG_DEBUG_KMEMLEAK_EARLY_LOG_SIZE=3600
CONFIG_DEBUG_KMEMLEAK_DEFAULT_OFF=y
CONFIG_PANIC_ON_OOPS=y
CONFIG_PANIC_TIMEOUT=5
CONFIG_SCHEDSTATS=y
CONFIG_SCHED_STACK_END_CHECK=y
CONFIG_PROVE_LOCKING=y
CONFIG_DEBUG_LOCKDEP=y
CONFIG_DEBUG_ATOMIC_SLEEP=y
CONFIG_DEBUG_LIST=y
CONFIG_RCU_CPU_STALL_TIMEOUT=60
CONFIG_RCU_TRACE=y
CONFIG_FAULT_INJECTION=y
CONFIG_ENABLE_DEFAULT_TRACERS=y
CONFIG_MTK_SCHED_TRACERS=y
CONFIG_MTK_FTRACE_DEFAULT_ENABLE=y
CONFIG_DMA_API_DEBUG=y
CONFIG_KGDB=y
CONFIG_KGDB_KDB=y
CONFIG_SECURITY_SELINUX_BOOTPARAM=y
CONFIG_CRYPTO_TWOFISH=y
CONFIG_CRYPTO_LZO=y
# CONFIG_CRYPTO_HW is not set
#ifdef VENDOR_EDIT
#Mingqiang.Guo@PSW.BSP.TP.Function, 2017/11/04, Add for TP common driver S4310
#CONFIG_TOUCHPANEL_MTK_PLATFORM=y
#CONFIG_TOUCHPANEL_OPPO=y
#CONFIG_TOUCHPANEL_SYNAPTICS=y
#CONFIG_TOUCHPANEL_SYNAPTICS_TD4310=y
#CONFIG_TOUCHPANEL_SYNAPTICS_TCM=y
#CONFIG_TOUCHPANEL_SYNAPTICS_S3706=y
#CONFIG_TOUCHPANEL_HIMAX=y
#CONFIG_TOUCHPANEL_HIMAX_HX83112B=y
#CONFIG_TOUCHPANEL_NOVA=y
#CONFIG_TOUCHPANEL_NOVA_NT36672=y
#CONFIG_TOUCHPANEL_GOODIX=y
#CONFIG_TOUCHPANEL_GOODIX_GT9286=y
#endif /* VENDOR_EDIT */
#ifdef VENDOR_EDIT
#Fuchun.Liao@BSP.CHG.Basic 2017/12/06 modify for build error in build
CONFIG_SECTION_MISMATCH_WARN_ONLY=y
#endif /* VENDOR_EDIT */
#ifdef VENDOR_EDIT
# Bin.Li@PSW.BSP.Fingerprint.Basic, 2017/11/22, Add for FPC driver baseon trustonic tee
CONFIG_OPPO_ARCH_FILE=y
CONFIG_OPPO_DEVICE_IFNO=y
CONFIG_OPPO_COMMON_SOFT=y
#endif /* VENDOR_EDIT */
#/* ChaoYing.Chen@EXP.BSP.CHG.basic, 2017/05/16, Add for charge driver */
CONFIG_OPPO_CHARGER_MTK6771=y
CONFIG_OPPO_CHARGER=y
CONFIG_OPPO_CHARGER_MTK=y
CONFIG_MTK_ADDITIONAL_BATTERY_TABLE=y
CONFIG_OPPO_4400MV_BATTERY_SUPPORT=y
CONFIG_MTK_HAFG_30=y
CONFIG_OPPO_CALL_MODE_SUPPORT=y
CONFIG_OPPO_CHECK_CHARGERID_VOLT=y
CONFIG_OPPO_SHIP_MODE_SUPPORT=y
#endif /* VENDOR_EDIT */
#ifdef VENDOR_EDIT
# Yongzhi.Zhang@PSW.MM.AudioDriver.Machine, 2017/10/27, add for TFA9890 ALSA driver
CONFIG_MTK_FM_50KHZ_SUPPORT=y
#endif /*VENDOR_EDIT*/
#tongfeng.Huang@BSP.BaseDrv.CHG.Basic, 2018/02/05  Add for battery unnormal
#Jun.Wei@RM.BSP.CHG.Basic, 2018/11/07, not support short_c in 18601
#CONFIG_OPPO_SHORT_C_BATT_CHECK is not set
#CONFIG_OPPO_SHORT_HW_CHECK is not set
#endif
#ifdef VENDOR_EDIT
#Qiao.Hu@BSP.BaseDrv.CHG.Basic, 2017/12/12  Add for check rtc time support
CONFIG_OPPO_RTC_DET_SUPPORT=y
#endif /*VENDOR_EDIT*/
#ifdef VENDOR_EDIT
# Tao.Ouyang@RM.MM.AudioDriver.Machine, 2018/10/27, Add for 50KHz space support
CONFIG_MTK_FM_50KHZ_SUPPORT=y
#Qiao.Hu@BSP.BaseDrv.CHG.Basic, 2018/03/27, Add for support AMKETEE GamePad
CONFIG_HID_SONY=y
CONFIG_HID_BETOP_FF=y
#endif /*VENDOR_EDIT*/

#ifdef VENDOR_EDIT////Chunyi.Mei@PSW.BSP.FS.exFAT,add 2018/9/12 for kernel 4.4 exfat	
CONFIG_EXFAT_FS=y
# endif
#ifdef VENDOR_EDIT
#/* Tong.Han@BSP.Group.Tp, 2017/05/04, Add for Joystick */
CONFIG_INPUT_JOYSTICK=y
CONFIG_JOYSTICK_XPAD=y
CONFIG_JOYSTICK_XPAD_FF=y
CONFIG_JOYSTICK_XPAD_LEDS=y
#endif /* VENDOR_EDIT */

#fanhui@PhonwSW.BSP, 2017-4-24, enable UID_CPUTIME
CONFIG_UID_CPUTIME=y
#endif

#ifdef VENDOR_EDIT
#Hongdao.yu@BSP.Fingerprint.Basic, 2018/09/17, add for open trustonic tee.
CONFIG_TRUSTONIC_TEE_SUPPORT=y
CONFIG_MTK_TEE_GP_SUPPORT=y
#endif /*VENDOR_EDIT*/

#ifdef VENDOR_EDIT
# Long.Liu@PSW.BSP.Fingerprint.Basic, 2018/9/25, Add for fingerprint driver
CONFIG_OPPO_FINGERPRINT=y
CONFIG_OPPO_FINGERPRINT_MTK=y
#endif /*VENDOR_EDIT*/




CONFIG_MODULE_FORCE_LOAD=y
CONFIG_MODULE_FORCE_UNLOAD=y

#ifdef VENDOR_EDIT
CONFIG_OPPO_HYPNUS=y
#endif
```
