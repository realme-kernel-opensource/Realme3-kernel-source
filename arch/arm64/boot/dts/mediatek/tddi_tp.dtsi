/*
 * Copyright (C) 2010 - 2017 Novatek, Inc.
 *
 * $Revision$
 * $Date$
 *
 * This program is free software; you can redistribute it and/or modify
 * it under the terms of the GNU General Public License as published by
 * the Free Software Foundation; either version 2 of the License, or
 * (at your option) any later version.
 *
 * This program is distributed in the hope that it will be useful, but WITHOUT
 * ANY WARRANTY; without even the implied warranty of MERCHANTABILITY or
 * FITNESS FOR A PARTICULAR PURPOSE.  See the GNU General Public License for
 * more details.
 *
 */


&spi5 {
	status = "ok";
	tddi_tp@0 {
		compatible = "tchip,tp";
		reg = <0>; //Same as CS ID
		status = "ok";
		spi-max-frequency = <9600000>;	//4800000,9600000,15000000,19200000
		touch,reset-gpio = <&pio 150 0>;
		touch,irq-gpio = <&pio 1 0>;
		/* 525 */
		novatek,swrst-n8-addr = <0x01F01A>;

		/* 672A */
		//novatek,swrst-n8-addr = <0x03F0FE>;

		/* MP */
		novatek,mp-support-dt;

		novatek-mp-criteria-5F1A@0 {
			#address-cells = <1>;
			#size-cells = <0>;
			compatible = "novatek-mp-criteria-5F1A";

			/* MP Config */
			IC_X_CFG_SIZE = <18>;
			IC_Y_CFG_SIZE = <32>;
			IC_KEY_CFG_SIZE = <4>;
			X_Channel = <18>;
			Y_Channel = <32>;
			AIN_X = <0 1 2 3 4 5 6 7 8 9 10 11 12 13 14 15 16 17>;
			AIN_Y = <0 1 2 3 4 5 6 7 8 9 10 11 12 13 14 15 16 17 18 19
								20 21 22 23 24 25 26 27 28 29 30 31>;
			AIN_KEY = <0 1 2 0xFF>;

			/* MP Criteria */
			PS_Config_Lmt_Short_Rawdata_P = <
				14008 14008 14008 14008 14008 14008 14008 14008 14008 14008 14008 14008 14008 14008 14008 14008 14008 14008
				14008 14008 14008 14008 14008 14008 14008 14008 14008 14008 14008 14008 14008 14008 14008 14008 14008 14008
				14008 14008 14008 14008 14008 14008 14008 14008 14008 14008 14008 14008 14008 14008 14008 14008 14008 14008
				14008 14008 14008 14008 14008 14008 14008 14008 14008 14008 14008 14008 14008 14008 14008 14008 14008 14008
				14008 14008 14008 14008 14008 14008 14008 14008 14008 14008 14008 14008 14008 14008 14008 14008 14008 14008
				14008 14008 14008 14008 14008 14008 14008 14008 14008 14008 14008 14008 14008 14008 14008 14008 14008 14008
				14008 14008 14008 14008 14008 14008 14008 14008 14008 14008 14008 14008 14008 14008 14008 14008 14008 14008
				14008 14008 14008 14008 14008 14008 14008 14008 14008 14008 14008 14008 14008 14008 14008 14008 14008 14008
				14008 14008 14008 14008 14008 14008 14008 14008 14008 14008 14008 14008 14008 14008 14008 14008 14008 14008
				14008 14008 14008 14008 14008 14008 14008 14008 14008 14008 14008 14008 14008 14008 14008 14008 14008 14008
				14008 14008 14008 14008 14008 14008 14008 14008 14008 14008 14008 14008 14008 14008 14008 14008 14008 14008
				14008 14008 14008 14008 14008 14008 14008 14008 14008 14008 14008 14008 14008 14008 14008 14008 14008 14008
				14008 14008 14008 14008 14008 14008 14008 14008 14008 14008 14008 14008 14008 14008 14008 14008 14008 14008
				14008 14008 14008 14008 14008 14008 14008 14008 14008 14008 14008 14008 14008 14008 14008 14008 14008 14008
				14008 14008 14008 14008 14008 14008 14008 14008 14008 14008 14008 14008 14008 14008 14008 14008 14008 14008
				14008 14008 14008 14008 14008 14008 14008 14008 14008 14008 14008 14008 14008 14008 14008 14008 14008 14008
				14008 14008 14008 14008 14008 14008 14008 14008 14008 14008 14008 14008 14008 14008 14008 14008 14008 14008
				14008 14008 14008 14008 14008 14008 14008 14008 14008 14008 14008 14008 14008 14008 14008 14008 14008 14008
				14008 14008 14008 14008 14008 14008 14008 14008 14008 14008 14008 14008 14008 14008 14008 14008 14008 14008
				14008 14008 14008 14008 14008 14008 14008 14008 14008 14008 14008 14008 14008 14008 14008 14008 14008 14008
				14008 14008 14008 14008 14008 14008 14008 14008 14008 14008 14008 14008 14008 14008 14008 14008 14008 14008
				14008 14008 14008 14008 14008 14008 14008 14008 14008 14008 14008 14008 14008 14008 14008 14008 14008 14008
				14008 14008 14008 14008 14008 14008 14008 14008 14008 14008 14008 14008 14008 14008 14008 14008 14008 14008
				14008 14008 14008 14008 14008 14008 14008 14008 14008 14008 14008 14008 14008 14008 14008 14008 14008 14008
				14008 14008 14008 14008 14008 14008 14008 14008 14008 14008 14008 14008 14008 14008 14008 14008 14008 14008
				14008 14008 14008 14008 14008 14008 14008 14008 14008 14008 14008 14008 14008 14008 14008 14008 14008 14008
				14008 14008 14008 14008 14008 14008 14008 14008 14008 14008 14008 14008 14008 14008 14008 14008 14008 14008
				14008 14008 14008 14008 14008 14008 14008 14008 14008 14008 14008 14008 14008 14008 14008 14008 14008 14008
				14008 14008 14008 14008 14008 14008 14008 14008 14008 14008 14008 14008 14008 14008 14008 14008 14008 14008
				14008 14008 14008 14008 14008 14008 14008 14008 14008 14008 14008 14008 14008 14008 14008 14008 14008 14008
				14008 14008 14008 14008 14008 14008 14008 14008 14008 14008 14008 14008 14008 14008 14008 14008 14008 14008
				14008 14008 14008 14008 14008 14008 14008 14008 14008 14008 14008 14008 14008 14008 14008 14008 14008 14008
				>;

			PS_Config_Lmt_Short_Rawdata_N = <
				11376 11376 11376 11376 11376 11376 11376 11376 11376 11376 11376 11376 11376 11376 11376 11376 11376 11376
				11376 11376 11376 11376 11376 11376 11376 11376 11376 11376 11376 11376 11376 11376 11376 11376 11376 11376
				11376 11376 11376 11376 11376 11376 11376 11376 11376 11376 11376 11376 11376 11376 11376 11376 11376 11376
				11376 11376 11376 11376 11376 11376 11376 11376 11376 11376 11376 11376 11376 11376 11376 11376 11376 11376
				11376 11376 11376 11376 11376 11376 11376 11376 11376 11376 11376 11376 11376 11376 11376 11376 11376 11376
				11376 11376 11376 11376 11376 11376 11376 11376 11376 11376 11376 11376 11376 11376 11376 11376 11376 11376
				11376 11376 11376 11376 11376 11376 11376 11376 11376 11376 11376 11376 11376 11376 11376 11376 11376 11376
				11376 11376 11376 11376 11376 11376 11376 11376 11376 11376 11376 11376 11376 11376 11376 11376 11376 11376
				11376 11376 11376 11376 11376 11376 11376 11376 11376 11376 11376 11376 11376 11376 11376 11376 11376 11376
				11376 11376 11376 11376 11376 11376 11376 11376 11376 11376 11376 11376 11376 11376 11376 11376 11376 11376
				11376 11376 11376 11376 11376 11376 11376 11376 11376 11376 11376 11376 11376 11376 11376 11376 11376 11376
				11376 11376 11376 11376 11376 11376 11376 11376 11376 11376 11376 11376 11376 11376 11376 11376 11376 11376
				11376 11376 11376 11376 11376 11376 11376 11376 11376 11376 11376 11376 11376 11376 11376 11376 11376 11376
				11376 11376 11376 11376 11376 11376 11376 11376 11376 11376 11376 11376 11376 11376 11376 11376 11376 11376
				11376 11376 11376 11376 11376 11376 11376 11376 11376 11376 11376 11376 11376 11376 11376 11376 11376 11376
				11376 11376 11376 11376 11376 11376 11376 11376 11376 11376 11376 11376 11376 11376 11376 11376 11376 11376
				11376 11376 11376 11376 11376 11376 11376 11376 11376 11376 11376 11376 11376 11376 11376 11376 11376 11376
				11376 11376 11376 11376 11376 11376 11376 11376 11376 11376 11376 11376 11376 11376 11376 11376 11376 11376
				11376 11376 11376 11376 11376 11376 11376 11376 11376 11376 11376 11376 11376 11376 11376 11376 11376 11376
				11376 11376 11376 11376 11376 11376 11376 11376 11376 11376 11376 11376 11376 11376 11376 11376 11376 11376
				11376 11376 11376 11376 11376 11376 11376 11376 11376 11376 11376 11376 11376 11376 11376 11376 11376 11376
				11376 11376 11376 11376 11376 11376 11376 11376 11376 11376 11376 11376 11376 11376 11376 11376 11376 11376
				11376 11376 11376 11376 11376 11376 11376 11376 11376 11376 11376 11376 11376 11376 11376 11376 11376 11376
				11376 11376 11376 11376 11376 11376 11376 11376 11376 11376 11376 11376 11376 11376 11376 11376 11376 11376
				11376 11376 11376 11376 11376 11376 11376 11376 11376 11376 11376 11376 11376 11376 11376 11376 11376 11376
				11376 11376 11376 11376 11376 11376 11376 11376 11376 11376 11376 11376 11376 11376 11376 11376 11376 11376
				11376 11376 11376 11376 11376 11376 11376 11376 11376 11376 11376 11376 11376 11376 11376 11376 11376 11376
				11376 11376 11376 11376 11376 11376 11376 11376 11376 11376 11376 11376 11376 11376 11376 11376 11376 11376
				11376 11376 11376 11376 11376 11376 11376 11376 11376 11376 11376 11376 11376 11376 11376 11376 11376 11376
				11376 11376 11376 11376 11376 11376 11376 11376 11376 11376 11376 11376 11376 11376 11376 11376 11376 11376
				11376 11376 11376 11376 11376 11376 11376 11376 11376 11376 11376 11376 11376 11376 11376 11376 11376 11376
				11376 11376 11376 11376 11376 11376 11376 11376 11376 11376 11376 11376 11376 11376 11376 11376 11376 11376
				>;

			PS_Config_Lmt_Open_Rawdata_P = <
				65535 3129 3109	3088 2913 2797 2764 2534 65535 65535 2554 2786 2822 2940 3116 3140 3167 65535
				1966 1869 1856 1847 1844 1840 1826 1799 1805 1831 1823 1851 1865 1862 1868 1876 1890 2002
				1984 1896 1884 1877 1875 1873 1861 1844 1875 1904 1868 1884 1897 1893 1893 1898 1912 2020
				1953 1865 1854 1847 1844 1841 1830 1812 1840 1873 1840 1856 1869 1865 1865 1870 1883 1989
				1926 1841 1830 1821 1819 1814 1803 1785 1814 1838 1805 1820 1833 1828 1828 1835 1847 1953
				1919 1834 1821 1814 1813 1809 1796 1778 1807 1834 1800 1819 1830 1826 1824 1831 1844 1947
				1953 1868 1852 1845 1844 1841 1828 1809 1838 1877 1844 1861 1872 1868 1868 1873 1886 1991
				1949 1863 1849 1842 1841 1837 1826 1806 1835 1858 1824 1842 1855 1849 1851 1855 1868 1971
				1921 1834 1819 1812 1812 1809 1796 1779 1807 1833 1799 1817 1827 1824 1824 1830 1842 1945
				1911 1823 1809 1803 1802 1799 1789 1770 1798 1819 1785 1803 1814 1810 1810 1814 1828 1928
				1957 1866 1854 1847 1847 1844 1833 1814 1842 1869 1835 1854 1865 1861 1862 1865 1877 1980
				1943 1854 1840 1834 1834 1831 1820 1802 1830 1854 1823 1841 1851 1848 1848 1852 1862 1964
				1904 1817 1803 1798 1798 1795 1784 1765 1793 1833 1802 1819 1830 1827 1826 1830 1841 1940
				1912 1826 1813 1809 1807 1805 1793 1775 1803 1814 1782 1800 1810 1807 1806 1810 1820 1918
				1953 1868 1855 1849 1849 1845 1835 1816 1844 1858 1827 1844 1855 1851 1849 1854 1865 1964
				1924 1838 1826 1821 1821 1817 1806 1788 1816 1861 1827 1847 1856 1854 1852 1856 1865 1963
				1905 1816 1806 1798 1800 1796 1786 1764 1795 1831 1792 1813 1819 1821 1821 1821 1831 1929
				1910 1824 1810 1802 1805 1799 1788 1768 1798 1823 1784 1803 1809 1812 1812 1812 1826 1919
				1949 1868 1845 1837 1838 1833 1824 1802 1833 1861 1821 1841 1847 1848 1849 1848 1869 1957
				1938 1858 1838 1830 1830 1824 1813 1796 1826 1858 1820 1838 1845 1847 1845 1845 1866 1953
				1908 1830 1813 1805 1802 1796 1785 1767 1795 1814 1777 1795 1800 1802 1806 1806 1823 1907
				1907 1833 1821 1813 1803 1796 1785 1765 1796 1809 1772 1791 1796 1799 1810 1812 1819 1901
				1926 1852 1841 1833 1823 1814 1805 1784 1814 1858 1820 1840 1847 1848 1859 1859 1870 1952
				1933 1861 1848 1841 1835 1824 1813 1793 1823 1852 1816 1835 1841 1848 1854 1855 1863 1946
				1897 1823 1812 1803 1806 1788 1777 1758 1788 1823 1788 1806 1812 1827 1827 1824 1834 1915
				1903 1831 1820 1813 1813 1796 1786 1768 1796 1816 1779 1799 1805 1817 1819 1817 1827 1905
				1932 1861 1849 1842 1844 1828 1817 1795 1826 1844 1807 1830 1835 1847 1848 1847 1856 1933
				1926 1855 1844 1838 1840 1833 1821 1791 1821 1835 1820 1851 1858 1861 1861 1859 1869 1946
				1889 1820 1809 1800 1803 1796 1786 1756 1785 1796 1760 1792 1800 1802 1803 1802 1810 1886
				1637 1840 1828 1821 1823 1817 1806 1777 1809 1824 1788 1819 1824 1827 1828 1827 1837 1638
				1637 1826 1816 1809 1810 1805 1792 1761 1793 1827 1789 1820 1827 1848 1848 1831 1858 1673
				1781 1912 1908 1903 1901 1897 1887 1861 1905 1917 1865 1894 1901 1921 1907 1907 1912 1812
				>;

			PS_Config_Lmt_Open_Rawdata_N = <
				(-65535) 1341 1333 1324 1249 1199 1184 1086 (-65535) (-65535) 1094 1194 1210 1260 1336 1346 1357 (-65535)
				842 801 796 791 790 788 782 771 773 785 781 793 799 798 800 804 810 858
				850 812 808 805 803 803 797 790 803 816 800 808 813 811 811 814 820 866
				837 799 794 791 790 789 784 776 788 803 788 796 801 799 799 802 807 853
				826 789 784 781 779 778 773 765 778 788 773 780 785 784 784 787 791 837
				823 786 781 778 777 775 770 762 775 786 772 779 784 782 782 785 790 835
				837 800 794 791 790 789 784 775 788 805 790 797 802 800 800 803 808 853
				835 799 793 790 789 787 782 774 787 796 782 790 795 793 793 795 800 845
				823 786 779 776 776 775 770 763 775 785 771 779 783 782 782 784 790 833
				819 781 775 773 772 771 767 758 770 779 765 773 778 776 776 778 784 826
				839 800 794 791 791 790 785 778 790 801 787 794 799 797 798 799 805 848
				833 794 788 786 786 785 780 772 784 794 781 789 793 792 792 794 798 842
				816 779 773 770 770 769 764 757 769 785 772 779 784 783 782 784 789 832
				820 782 777 775 775 773 769 761 773 778 764 772 776 775 774 776 780 822
				837 800 795 793 793 791 787 778 790 796 783 790 795 793 793 794 799 842
				824 788 782 781 781 779 774 766 778 797 783 791 796 794 794 796 799 841
				817 778 774 770 772 770 766 756 769 785 768 777 779 781 781 781 785 827
				818 782 776 772 773 771 766 758 770 781 764 773 775 776 776 776 782 823
				835 800 791 787 788 785 782 772 785 797 781 789 791 792 793 792 801 839
				830 796	788	784	784	782	777	770	782	796	780	788	791	791	791	791	800	837
				818	784	777	773	772	770	765	757	769	778	761	769	772	772	774	774	781	817
				817	785	781	777	773	770	765	757	770	775	760	767	770	771	776	776	779	815
				826	794	789	785	781	778	773	764	778	796	780	788	791	792	797	797	802	836
				829	797	792	789	787	782	777	769	781	794	778	787	789	792	794	795	799	834
				813	781	776	773	774	766	761	754	766	781	766	774	776	783	783	782	786	821
				815	785	780	777	777	770	766	758	770	778	763	771	773	779	779	779	783	817
				828	797	793	790	790	784	779	769	782	790	775	784 787 791 792 791 796 829
				826 795 790 788 788	785 781 767 781 787 780 793 796 797 797 797 801 834
				809 780 775 772 773 770 766 752 765 770 754 768 772 772 773 772 776 808
				701 788 784 781 781 779 774 761 775 782 766 779 782 783 784 783 787 702
				701 782 778 775 776 773 768 755 769 783 767 780 783 792 792 785 796 717
				763 820 818 815 815 813 809 797 817 821 799 812 815 823 817 817 820 776
				>;

			PS_Config_Lmt_FW_Rawdata_P = <
				65535 1700 1700 1700 1700 1700 1700 1700 65535 65535 1700 1700 1700 1700 1700 1700 1700 65535
				1700 1700 1700 1700 1700 1700 1700 1700 1700 1700 1700 1700 1700 1700 1700 1700 1700 1700
				1700 1700 1700 1700 1700 1700 1700 1700 1700 1700 1700 1700 1700 1700 1700 1700 1700 1700
				1700 1700 1700 1700 1700 1700 1700 1700 1700 1700 1700 1700 1700 1700 1700 1700 1700 1700
				1700 1700 1700 1700 1700 1700 1700 1700 1700 1700 1700 1700 1700 1700 1700 1700 1700 1700
				1700 1700 1700 1700 1700 1700 1700 1700 1700 1700 1700 1700 1700 1700 1700 1700 1700 1700
				1700 1700 1700 1700 1700 1700 1700 1700 1700 1700 1700 1700 1700 1700 1700 1700 1700 1700
				1700 1700 1700 1700 1700 1700 1700 1700 1700 1700 1700 1700 1700 1700 1700 1700 1700 1700
				1700 1700 1700 1700 1700 1700 1700 1700 1700 1700 1700 1700 1700 1700 1700 1700 1700 1700
				1700 1700 1700 1700 1700 1700 1700 1700 1700 1700 1700 1700 1700 1700 1700 1700 1700 1700
				1700 1700 1700 1700 1700 1700 1700 1700 1700 1700 1700 1700 1700 1700 1700 1700 1700 1700
				1700 1700 1700 1700 1700 1700 1700 1700 1700 1700 1700 1700 1700 1700 1700 1700 1700 1700
				1700 1700 1700 1700 1700 1700 1700 1700 1700 1700 1700 1700 1700 1700 1700 1700 1700 1700
				1700 1700 1700 1700 1700 1700 1700 1700 1700 1700 1700 1700 1700 1700 1700 1700 1700 1700
				1700 1700 1700 1700 1700 1700 1700 1700 1700 1700 1700 1700 1700 1700 1700 1700 1700 1700
				1700 1700 1700 1700 1700 1700 1700 1700 1700 1700 1700 1700 1700 1700 1700 1700 1700 1700
				1700 1700 1700 1700 1700 1700 1700 1700 1700 1700 1700 1700 1700 1700 1700 1700 1700 1700
				1700 1700 1700 1700 1700 1700 1700 1700 1700 1700 1700 1700 1700 1700 1700 1700 1700 1700
				1700 1700 1700 1700 1700 1700 1700 1700 1700 1700 1700 1700 1700 1700 1700 1700 1700 1700
				1700 1700 1700 1700 1700 1700 1700 1700 1700 1700 1700 1700 1700 1700 1700 1700 1700 1700
				1700 1700 1700 1700 1700 1700 1700 1700 1700 1700 1700 1700 1700 1700 1700 1700 1700 1700
				1700 1700 1700 1700 1700 1700 1700 1700 1700 1700 1700 1700 1700 1700 1700 1700 1700 1700
				1700 1700 1700 1700 1700 1700 1700 1700 1700 1700 1700 1700 1700 1700 1700 1700 1700 1700
				1700 1700 1700 1700 1700 1700 1700 1700 1700 1700 1700 1700 1700 1700 1700 1700 1700 1700
				1700 1700 1700 1700 1700 1700 1700 1700 1700 1700 1700 1700 1700 1700 1700 1700 1700 1700
				1700 1700 1700 1700 1700 1700 1700 1700 1700 1700 1700 1700 1700 1700 1700 1700 1700 1700
				1700 1700 1700 1700 1700 1700 1700 1700 1700 1700 1700 1700 1700 1700 1700 1700 1700 1700
				1700 1700 1700 1700 1700 1700 1700 1700 1700 1700 1700 1700 1700 1700 1700 1700 1700 1700
				1700 1700 1700 1700 1700 1700 1700 1700 1700 1700 1700 1700 1700 1700 1700 1700 1700 1700
				1700 1700 1700 1700 1700 1700 1700 1700 1700 1700 1700 1700 1700 1700 1700 1700 1700 1700
				1700 1700 1700 1700 1700 1700 1700 1700 1700 1700 1700 1700 1700 1700 1700 1700 1700 1700
				1700 1700 1700 1700 1700 1700 1700 1700 1700 1700 1700 1700 1700 1700 1700 1700 1700 1700
				>;

			PS_Config_Lmt_FW_Rawdata_N = <
				(-65535) 700 700 700 700 700 700 700 (-65535) (-65535) 700 700 700 700 700 700 700 (-65535)
				700 700 700 700 700 700 700 700 700 700 700 700 700 700 700 700 700 700
				700 700 700 700 700 700 700 700 700 700 700 700 700 700 700 700 700 700
				700 700 700 700 700 700 700 700 700 700 700 700 700 700 700 700 700 700
				700 700 700 700 700 700 700 700 700 700 700 700 700 700 700 700 700 700
				700 700 700 700 700 700 700 700 700 700 700 700 700 700 700 700 700 700
				700 700 700 700 700 700 700 700 700 700 700 700 700 700 700 700 700 700
				700 700 700 700 700 700 700 700 700 700 700 700 700 700 700 700 700 700
				700 700 700 700 700 700 700 700 700 700 700 700 700 700 700 700 700 700
				700 700 700 700 700 700 700 700 700 700 700 700 700 700 700 700 700 700
				700 700 700 700 700 700 700 700 700 700 700 700 700 700 700 700 700 700
				700 700 700 700 700 700 700 700 700 700 700 700 700 700 700 700 700 700
				700 700 700 700 700 700 700 700 700 700 700 700 700 700 700 700 700 700
				700 700 700 700 700 700 700 700 700 700 700 700 700 700 700 700 700 700
				700 700 700 700 700 700 700 700 700 700 700 700 700 700 700 700 700 700
				700 700 700 700 700 700 700 700 700 700 700 700 700 700 700 700 700 700
				700 700 700 700 700 700 700 700 700 700 700 700 700 700 700 700 700 700
				700 700 700 700 700 700 700 700 700 700 700 700 700 700 700 700 700 700
				700 700 700 700 700 700 700 700 700 700 700 700 700 700 700 700 700 700
				700 700 700 700 700 700 700 700 700 700 700 700 700 700 700 700 700 700
				700 700 700 700 700 700 700 700 700 700 700 700 700 700 700 700 700 700
				700 700 700 700 700 700 700 700 700 700 700 700 700 700 700 700 700 700
				700 700 700 700 700 700 700 700 700 700 700 700 700 700 700 700 700 700
				700 700 700 700 700 700 700 700 700 700 700 700 700 700 700 700 700 700
				700 700 700 700 700 700 700 700 700 700 700 700 700 700 700 700 700 700
				700 700 700 700 700 700 700 700 700 700 700 700 700 700 700 700 700 700
				700 700 700 700 700 700 700 700 700 700 700 700 700 700 700 700 700 700
				700 700 700 700 700 700 700 700 700 700 700 700 700 700 700 700 700 700
				700 700 700 700 700 700 700 700 700 700 700 700 700 700 700 700 700 700
				700 700 700 700 700 700 700 700 700 700 700 700 700 700 700 700 700 700
				700 700 700 700 700 700 700 700 700 700 700 700 700 700 700 700 700 700
				700 700 700 700 700 700 700 700 700 700 700 700 700 700 700 700 700 700
				>;

			PS_Config_Lmt_FW_CC_P = <
				65535 145 145 145 146 148 146 146 65535 65535 148 149 150 149 148 148 146 65535
				148 146 146 146 148 148 148 149 149 150 150 149 149 149 148 148 148 149
				148 145 145 145 146 146 146 146 149 153 150 149 149 149 148 148 148 149
				149 146 146 146 148 148 148 149 152 156 152 152 152 152 150 150 150 152
				149 148 148 148 148 148 149 149 153 153 150 149 149 149 149 148 148 150
				149 148 148 148 149 149 149 149 153 153 150 150 150 150 149 149 149 150
				149 146 146 146 146 148 148 148 152 156 153 153 152 152 152 150 150 153
				150 148 148 148 149 149 149 150 153 156 152 152 152 152 150 150 149 152
				150 148 148 148 149 149 149 149 153 155 152 150 150 150 149 149 149 152
				149 148 148 148 148 148 148 149 152 153 150 150 149 149 149 149 149 150
				149 148 148 148 148 148 149 149 152 156 152 152 150 150 150 150 150 152
				150 148 148 148 149 149 149 149 153 155 152 152 150 150 150 150 149 152
				149 146 146 146 148 148 148 148 152 155 152 150 150 150 149 149 149 152
				150 148 148 148 149 149 149 150 153 155 152 150 150 150 150 150 150 152
				150 148 148 148 149 149 149 150 153 157 153 153 152 152 152 152 152 155
				149 148 148 148 148 148 149 149 152 156 153 153 152 153 152 152 152 155
				150 149 149 149 149 149 149 150 153 155 152 150 150 150 150 150 150 153
				150 148 148 148 148 148 148 149 152 155 152 150 150 150 150 150 150 153
				152 149 149 149 149 149 149 150 153 157 153 153 153 153 152 152 152 155
				150 148 148 148 148 148 148 149 152 156 153 153 152 152 152 152 152 155
				149 148 148 148 148 148 148 148 152 155 152 150 150 150 150 150 150 153
				150 148 148 148 148 148 148 149 152 155 152 152 150 150 150 150 150 153
				149 146 146 146 148 148 148 148 150 156 153 153 152 152 152 152 152 155
				150 149 149 149 149 149 149 150 153 155 152 152 152 152 150 150 150 153
				150 149 149 149 149 149 149 149 153 156 152 152 152 152 150 150 150 153
				152 149 149 149 150 150 150 150 153 155 152 152 152 152 150 150 150 153
				152 149 149 149 150 150 150 150 155 156 153 153 152 152 152 152 152 155
				150 148 148 149 149 149 149 149 153 157 153 153 153 153 153 153 153 155
				152 149 149 149 149 149 149 150 153 155 152 150 150 150 150 150 150 153
				145 146 146 146 148 148 148 148 152 153 150 150 149 149 149 149 149 146
				145 148 148 148 149 149 149 149 153 157 153 153 153 153 153 152 153 149
				142 145 146 146 146 146 146 148 152 155 150 150 150 150 149 149 148 145
				>;

			PS_Config_Lmt_FW_CC_N = <
				(-65535) 70 70 70 70 70 70 70 (-65535) (-65535) 70 70 70 70 70 70 70 (-65535)
				70 70 70 70 70 70 70 70 70 70 70 70 70 70 70 70 70 70
				70 70 70 70 70 70 70 70 70 70 70 70 70 70 70 70 70 70
				70 70 70 70 70 70 70 70 70 70 70 70 70 70 70 70 70 70
				70 70 70 70 70 70 70 70 70 70 70 70 70 70 70 70 70 70
				70 70 70 70 70 70 70 70 70 70 70 70 70 70 70 70 70 70
				70 70 70 70 70 70 70 70 70 70 70 70 70 70 70 70 70 70
				70 70 70 70 70 70 70 70 70 70 70 70 70 70 70 70 70 70
				70 70 70 70 70 70 70 70 70 70 70 70 70 70 70 70 70 70
				70 70 70 70 70 70 70 70 70 70 70 70 70 70 70 70 70 70
				70 70 70 70 70 70 70 70 70 70 70 70 70 70 70 70 70 70
				70 70 70 70 70 70 70 70 70 70 70 70 70 70 70 70 70 70
				70 70 70 70 70 70 70 70 70 70 70 70 70 70 70 70 70 70
				70 70 70 70 70 70 70 70 70 70 70 70 70 70 70 70 70 70
				70 70 70 70 70 70 70 70 70 70 70 70 70 70 70 70 70 70
				70 70 70 70 70 70 70 70 70 70 70 70 70 70 70 70 70 70
				70 70 70 70 70 70 70 70 70 70 70 70 70 70 70 70 70 70
				70 70 70 70 70 70 70 70 70 70 70 70 70 70 70 70 70 70
				70 70 70 70 70 70 70 70 70 70 70 70 70 70 70 70 70 70
				70 70 70 70 70 70 70 70 70 70 70 70 70 70 70 70 70 70
				70 70 70 70 70 70 70 70 70 70 70 70 70 70 70 70 70 70
				70 70 70 70 70 70 70 70 70 70 70 70 70 70 70 70 70 70
				70 70 70 70 70 70 70 70 70 70 70 70 70 70 70 70 70 70
				70 70 70 70 70 70 70 70 70 70 70 70 70 70 70 70 70 70
				70 70 70 70 70 70 70 70 70 70 70 70 70 70 70 70 70 70
				70 70 70 70 70 70 70 70 70 70 70 70 70 70 70 70 70 70
				70 70 70 70 70 70 70 70 70 70 70 70 70 70 70 70 70 70
				70 70 70 70 70 70 70 70 70 70 70 70 70 70 70 70 70 70
				70 70 70 70 70 70 70 70 70 70 70 70 70 70 70 70 70 70
				70 70 70 70 70 70 70 70 70 70 70 70 70 70 70 70 70 70
				70 70 70 70 70 70 70 70 70 70 70 70 70 70 70 70 70 70
				70 70 70 70 70 70 70 70 70 70 70 70 70 70 70 70 70 70
				>;

			PS_Config_Lmt_FW_Diff_P = <
				65535 50 50 50 50 50 50 50 65535 65535 50 50 50 50 50 50 50 65535
				50 50 50 50 50 50    50    50    50    50    50    50 50 50 50 50 50 50
				50 50 50 50 50 50    50    50    50    50    50    50 50 50 50 50 50 50
				50 50 50 50 50 50    50    50    50    50    50    50 50 50 50 50 50 50
				50 50 50 50 50 50    50    50    50    50    50    50 50 50 50 50 50 50
				50 50 50 50 50 50    50    50    50    50    50    50 50 50 50 50 50 50
				50 50 50 50 50 50    50    50    50    50    50    50 50 50 50 50 50 50
				50 50 50 50 50 50    50    50    50    50    50    50 50 50 50 50 50 50
				50 50 50 50 50 50    50    50    50    50    50    50 50 50 50 50 50 50
				50 50 50 50 50 50    50    50    50    50    50    50 50 50 50 50 50 50
				50 50 50 50 50 50    50    50    50    50    50    50 50 50 50 50 50 50
				50 50 50 50 50 50    50    50    50    50    50    50 50 50 50 50 50 50
				50 50 50 50 50 50    50    50    50    50    50    50 50 50 50 50 50 50
				50 50 50 50 50 50    50    50    50    50    50    50 50 50 50 50 50 50
				50 50 50 50 50 50    50    50    50    50    50    50 50 50 50 50 50 50
				50 50 50 50 50 50    50    50    50    50    50    50 50 50 50 50 50 50
				50 50 50 50 50 50    50    50    50    50    50    50 50 50 50 50 50 50
				50 50 50 50 50 50    50    50    50    50    50    50 50 50 50 50 50 50
				50 50 50 50 50 50    50    50    50    50    50    50 50 50 50 50 50 50
				50 50 50 50 50 50    50    50    50    50    50    50 50 50 50 50 50 50
				50 50 50 50 50 50    50    50    50    50    50    50 50 50 50 50 50 50
				50 50 50 50 50 50    50    50    50    50    50    50 50 50 50 50 50 50
				50 50 50 50 50 50    50    50    50    50    50    50 50 50 50 50 50 50
				50 50 50 50 50 50    50    50    50    50    50    50 50 50 50 50 50 50
				50 50 50 50 50 50    50    50    50    50    50    50 50 50 50 50 50 50
				50 50 50 50 50 50    50    50    50    50    50    50 50 50 50 50 50 50
				50 50 50 50 50 50    50    50    50    50    50    50 50 50 50 50 50 50
				50 50 50 50 50 50    50    50    50    50    50    50 50 50 50 50 50 50
				50 50 50 50 50 50    50    50    50    50    50    50 50 50 50 50 50 50
				50 50 50 50 50 50    50    50    50    50    50    50 50 50 50 50 50 50
				50 50 50 50 50 50    50    50    50    50    50    50 50 50 50 50 50 50
				50 50 50 50 50 50    50    50    50    50    50    50 50 50 50 50 50 50
				>;

			PS_Config_Lmt_FW_Diff_N = <
				(-65535) (-50) (-50) (-50) (-50) (-50) (-50) (-50) (-65535) (-65535) (-50) (-50) (-50) (-50) (-50) (-50) (-50) (-65535)
				(-50) (-50) (-50) (-50) (-50) (-50)    (-50)    (-50)    (-50)    (-50)    (-50)    (-50) (-50) (-50) (-50) (-50) (-50) (-50)
				(-50) (-50) (-50) (-50) (-50) (-50)    (-50)    (-50)    (-50)    (-50)    (-50)    (-50) (-50) (-50) (-50) (-50) (-50) (-50)
				(-50) (-50) (-50) (-50) (-50) (-50)    (-50)    (-50)    (-50)    (-50)    (-50)    (-50) (-50) (-50) (-50) (-50) (-50) (-50)
				(-50) (-50) (-50) (-50) (-50) (-50)    (-50)    (-50)    (-50)    (-50)    (-50)    (-50) (-50) (-50) (-50) (-50) (-50) (-50)
				(-50) (-50) (-50) (-50) (-50) (-50)    (-50)    (-50)    (-50)    (-50)    (-50)    (-50) (-50) (-50) (-50) (-50) (-50) (-50)
				(-50) (-50) (-50) (-50) (-50) (-50)    (-50)    (-50)    (-50)    (-50)    (-50)    (-50) (-50) (-50) (-50) (-50) (-50) (-50)
				(-50) (-50) (-50) (-50) (-50) (-50)    (-50)    (-50)    (-50)    (-50)    (-50)    (-50) (-50) (-50) (-50) (-50) (-50) (-50)
				(-50) (-50) (-50) (-50) (-50) (-50)    (-50)    (-50)    (-50)    (-50)    (-50)    (-50) (-50) (-50) (-50) (-50) (-50) (-50)
				(-50) (-50) (-50) (-50) (-50) (-50)    (-50)    (-50)    (-50)    (-50)    (-50)    (-50) (-50) (-50) (-50) (-50) (-50) (-50)
				(-50) (-50) (-50) (-50) (-50) (-50)    (-50)    (-50)    (-50)    (-50)    (-50)    (-50) (-50) (-50) (-50) (-50) (-50) (-50)
				(-50) (-50) (-50) (-50) (-50) (-50)    (-50)    (-50)    (-50)    (-50)    (-50)    (-50) (-50) (-50) (-50) (-50) (-50) (-50)
				(-50) (-50) (-50) (-50) (-50) (-50)    (-50)    (-50)    (-50)    (-50)    (-50)    (-50) (-50) (-50) (-50) (-50) (-50) (-50)
				(-50) (-50) (-50) (-50) (-50) (-50)    (-50)    (-50)    (-50)    (-50)    (-50)    (-50) (-50) (-50) (-50) (-50) (-50) (-50)
				(-50) (-50) (-50) (-50) (-50) (-50)    (-50)    (-50)    (-50)    (-50)    (-50)    (-50) (-50) (-50) (-50) (-50) (-50) (-50)
				(-50) (-50) (-50) (-50) (-50) (-50)    (-50)    (-50)    (-50)    (-50)    (-50)    (-50) (-50) (-50) (-50) (-50) (-50) (-50)
				(-50) (-50) (-50) (-50) (-50) (-50)    (-50)    (-50)    (-50)    (-50)    (-50)    (-50) (-50) (-50) (-50) (-50) (-50) (-50)
				(-50) (-50) (-50) (-50) (-50) (-50)    (-50)    (-50)    (-50)    (-50)    (-50)    (-50) (-50) (-50) (-50) (-50) (-50) (-50)
				(-50) (-50) (-50) (-50) (-50) (-50)    (-50)    (-50)    (-50)    (-50)    (-50)    (-50) (-50) (-50) (-50) (-50) (-50) (-50)
				(-50) (-50) (-50) (-50) (-50) (-50)    (-50)    (-50)    (-50)    (-50)    (-50)    (-50) (-50) (-50) (-50) (-50) (-50) (-50)
				(-50) (-50) (-50) (-50) (-50) (-50)    (-50)    (-50)    (-50)    (-50)    (-50)    (-50) (-50) (-50) (-50) (-50) (-50) (-50)
				(-50) (-50) (-50) (-50) (-50) (-50)    (-50)    (-50)    (-50)    (-50)    (-50)    (-50) (-50) (-50) (-50) (-50) (-50) (-50)
				(-50) (-50) (-50) (-50) (-50) (-50)    (-50)    (-50)    (-50)    (-50)    (-50)    (-50) (-50) (-50) (-50) (-50) (-50) (-50)
				(-50) (-50) (-50) (-50) (-50) (-50)    (-50)    (-50)    (-50)    (-50)    (-50)    (-50) (-50) (-50) (-50) (-50) (-50) (-50)
				(-50) (-50) (-50) (-50) (-50) (-50)    (-50)    (-50)    (-50)    (-50)    (-50)    (-50) (-50) (-50) (-50) (-50) (-50) (-50)
				(-50) (-50) (-50) (-50) (-50) (-50)    (-50)    (-50)    (-50)    (-50)    (-50)    (-50) (-50) (-50) (-50) (-50) (-50) (-50)
				(-50) (-50) (-50) (-50) (-50) (-50)    (-50)    (-50)    (-50)    (-50)    (-50)    (-50) (-50) (-50) (-50) (-50) (-50) (-50)
				(-50) (-50) (-50) (-50) (-50) (-50)    (-50)    (-50)    (-50)    (-50)    (-50)    (-50) (-50) (-50) (-50) (-50) (-50) (-50)
				(-50) (-50) (-50) (-50) (-50) (-50)    (-50)    (-50)    (-50)    (-50)    (-50)    (-50) (-50) (-50) (-50) (-50) (-50) (-50)
				(-50) (-50) (-50) (-50) (-50) (-50)    (-50)    (-50)    (-50)    (-50)    (-50)    (-50) (-50) (-50) (-50) (-50) (-50) (-50)
				(-50) (-50) (-50) (-50) (-50) (-50)    (-50)    (-50)    (-50)    (-50)    (-50)    (-50) (-50) (-50) (-50) (-50) (-50) (-50)
				(-50) (-50) (-50) (-50) (-50) (-50)    (-50)    (-50)    (-50)    (-50)    (-50)    (-50) (-50) (-50) (-50) (-50) (-50) (-50)
				>;

			PS_Config_Diff_Test_Frame = <50>;

			PS_Config_Lmt_LPWG_Rawdata_P = <
				65535 1700 1700 1700 1700 1700 1700 1700 65535 65535 1700 1700 1700 1700 1700 1700 1700 65535
				1700 1700 1700 1700 1700 1700 1700 1700 1700 1700 1700 1700 1700 1700 1700 1700 1700 1700
				1700 1700 1700 1700 1700 1700 1700 1700 1700 1700 1700 1700 1700 1700 1700 1700 1700 1700
				1700 1700 1700 1700 1700 1700 1700 1700 1700 1700 1700 1700 1700 1700 1700 1700 1700 1700
				1700 1700 1700 1700 1700 1700 1700 1700 1700 1700 1700 1700 1700 1700 1700 1700 1700 1700
				1700 1700 1700 1700 1700 1700 1700 1700 1700 1700 1700 1700 1700 1700 1700 1700 1700 1700
				1700 1700 1700 1700 1700 1700 1700 1700 1700 1700 1700 1700 1700 1700 1700 1700 1700 1700
				1700 1700 1700 1700 1700 1700 1700 1700 1700 1700 1700 1700 1700 1700 1700 1700 1700 1700
				1700 1700 1700 1700 1700 1700 1700 1700 1700 1700 1700 1700 1700 1700 1700 1700 1700 1700
				1700 1700 1700 1700 1700 1700 1700 1700 1700 1700 1700 1700 1700 1700 1700 1700 1700 1700
				1700 1700 1700 1700 1700 1700 1700 1700 1700 1700 1700 1700 1700 1700 1700 1700 1700 1700
				1700 1700 1700 1700 1700 1700 1700 1700 1700 1700 1700 1700 1700 1700 1700 1700 1700 1700
				1700 1700 1700 1700 1700 1700 1700 1700 1700 1700 1700 1700 1700 1700 1700 1700 1700 1700
				1700 1700 1700 1700 1700 1700 1700 1700 1700 1700 1700 1700 1700 1700 1700 1700 1700 1700
				1700 1700 1700 1700 1700 1700 1700 1700 1700 1700 1700 1700 1700 1700 1700 1700 1700 1700
				1700 1700 1700 1700 1700 1700 1700 1700 1700 1700 1700 1700 1700 1700 1700 1700 1700 1700
				1700 1700 1700 1700 1700 1700 1700 1700 1700 1700 1700 1700 1700 1700 1700 1700 1700 1700
				1700 1700 1700 1700 1700 1700 1700 1700 1700 1700 1700 1700 1700 1700 1700 1700 1700 1700
				1700 1700 1700 1700 1700 1700 1700 1700 1700 1700 1700 1700 1700 1700 1700 1700 1700 1700
				1700 1700 1700 1700 1700 1700 1700 1700 1700 1700 1700 1700 1700 1700 1700 1700 1700 1700
				1700 1700 1700 1700 1700 1700 1700 1700 1700 1700 1700 1700 1700 1700 1700 1700 1700 1700
				1700 1700 1700 1700 1700 1700 1700 1700 1700 1700 1700 1700 1700 1700 1700 1700 1700 1700
				1700 1700 1700 1700 1700 1700 1700 1700 1700 1700 1700 1700 1700 1700 1700 1700 1700 1700
				1700 1700 1700 1700 1700 1700 1700 1700 1700 1700 1700 1700 1700 1700 1700 1700 1700 1700
				1700 1700 1700 1700 1700 1700 1700 1700 1700 1700 1700 1700 1700 1700 1700 1700 1700 1700
				1700 1700 1700 1700 1700 1700 1700 1700 1700 1700 1700 1700 1700 1700 1700 1700 1700 1700
				1700 1700 1700 1700 1700 1700 1700 1700 1700 1700 1700 1700 1700 1700 1700 1700 1700 1700
				1700 1700 1700 1700 1700 1700 1700 1700 1700 1700 1700 1700 1700 1700 1700 1700 1700 1700
				1700 1700 1700 1700 1700 1700 1700 1700 1700 1700 1700 1700 1700 1700 1700 1700 1700 1700
				1700 1700 1700 1700 1700 1700 1700 1700 1700 1700 1700 1700 1700 1700 1700 1700 1700 1700
				1700 1700 1700 1700 1700 1700 1700 1700 1700 1700 1700 1700 1700 1700 1700 1700 1700 1700
				1700 1700 1700 1700 1700 1700 1700 1700 1700 1700 1700 1700 1700 1700 1700 1700 1700 1700
				>;

			PS_Config_Lmt_LPWG_Rawdata_N = <
				(-65535) 700 700 700 700 700 700 700 (-65535) (-65535) 700 700 700 700 700 700 700 (-65535)
				700 700 700 700 700 700 700 700 700 700 700 700 700 700 700 700 700 700
				700 700 700 700 700 700 700 700 700 700 700 700 700 700 700 700 700 700
				700 700 700 700 700 700 700 700 700 700 700 700 700 700 700 700 700 700
				700 700 700 700 700 700 700 700 700 700 700 700 700 700 700 700 700 700
				700 700 700 700 700 700 700 700 700 700 700 700 700 700 700 700 700 700
				700 700 700 700 700 700 700 700 700 700 700 700 700 700 700 700 700 700
				700 700 700 700 700 700 700 700 700 700 700 700 700 700 700 700 700 700
				700 700 700 700 700 700 700 700 700 700 700 700 700 700 700 700 700 700
				700 700 700 700 700 700 700 700 700 700 700 700 700 700 700 700 700 700
				700 700 700 700 700 700 700 700 700 700 700 700 700 700 700 700 700 700
				700 700 700 700 700 700 700 700 700 700 700 700 700 700 700 700 700 700
				700 700 700 700 700 700 700 700 700 700 700 700 700 700 700 700 700 700
				700 700 700 700 700 700 700 700 700 700 700 700 700 700 700 700 700 700
				700 700 700 700 700 700 700 700 700 700 700 700 700 700 700 700 700 700
				700 700 700 700 700 700 700 700 700 700 700 700 700 700 700 700 700 700
				700 700 700 700 700 700 700 700 700 700 700 700 700 700 700 700 700 700
				700 700 700 700 700 700 700 700 700 700 700 700 700 700 700 700 700 700
				700 700 700 700 700 700 700 700 700 700 700 700 700 700 700 700 700 700
				700 700 700 700 700 700 700 700 700 700 700 700 700 700 700 700 700 700
				700 700 700 700 700 700 700 700 700 700 700 700 700 700 700 700 700 700
				700 700 700 700 700 700 700 700 700 700 700 700 700 700 700 700 700 700
				700 700 700 700 700 700 700 700 700 700 700 700 700 700 700 700 700 700
				700 700 700 700 700 700 700 700 700 700 700 700 700 700 700 700 700 700
				700 700 700 700 700 700 700 700 700 700 700 700 700 700 700 700 700 700
				700 700 700 700 700 700 700 700 700 700 700 700 700 700 700 700 700 700
				700 700 700 700 700 700 700 700 700 700 700 700 700 700 700 700 700 700
				700 700 700 700 700 700 700 700 700 700 700 700 700 700 700 700 700 700
				700 700 700 700 700 700 700 700 700 700 700 700 700 700 700 700 700 700
				700 700 700 700 700 700 700 700 700 700 700 700 700 700 700 700 700 700
				700 700 700 700 700 700 700 700 700 700 700 700 700 700 700 700 700 700
				700 700 700 700 700 700 700 700 700 700 700 700 700 700 700 700 700 700
				>;

			PS_Config_Lmt_LPWG_Diff_P = <
				65535 60 60 60 60 60 60 60 65535 65535 60 60 60 60 60 60 60 65535
				60 60 60 60 60 60 60 60 60 60 60 60 60 60 60 60 60 60
				60 60 60 60 60 60 60 60 60 60 60 60 60 60 60 60 60 60
				60 60 60 60 60 60 60 60 60 60 60 60 60 60 60 60 60 60
				60 60 60 60 60 60 60 60 60 60 60 60 60 60 60 60 60 60
				60 60 60 60 60 60 60 60 60 60 60 60 60 60 60 60 60 60
				60 60 60 60 60 60 60 60 60 60 60 60 60 60 60 60 60 60
				60 60 60 60 60 60 60 60 60 60 60 60 60 60 60 60 60 60
				60 60 60 60 60 60 60 60 60 60 60 60 60 60 60 60 60 60
				60 60 60 60 60 60 60 60 60 60 60 60 60 60 60 60 60 60
				60 60 60 60 60 60 60 60 60 60 60 60 60 60 60 60 60 60
				60 60 60 60 60 60 60 60 60 60 60 60 60 60 60 60 60 60
				60 60 60 60 60 60 60 60 60 60 60 60 60 60 60 60 60 60
				60 60 60 60 60 60 60 60 60 60 60 60 60 60 60 60 60 60
				60 60 60 60 60 60 60 60 60 60 60 60 60 60 60 60 60 60
				60 60 60 60 60 60 60 60 60 60 60 60 60 60 60 60 60 60
				60 60 60 60 60 60 60 60 60 60 60 60 60 60 60 60 60 60
				60 60 60 60 60 60 60 60 60 60 60 60 60 60 60 60 60 60
				60 60 60 60 60 60 60 60 60 60 60 60 60 60 60 60 60 60
				60 60 60 60 60 60 60 60 60 60 60 60 60 60 60 60 60 60
				60 60 60 60 60 60 60 60 60 60 60 60 60 60 60 60 60 60
				60 60 60 60 60 60 60 60 60 60 60 60 60 60 60 60 60 60
				60 60 60 60 60 60 60 60 60 60 60 60 60 60 60 60 60 60
				60 60 60 60 60 60 60 60 60 60 60 60 60 60 60 60 60 60
				60 60 60 60 60 60 60 60 60 60 60 60 60 60 60 60 60 60
				60 60 60 60 60 60 60 60 60 60 60 60 60 60 60 60 60 60
				60 60 60 60 60 60 60 60 60 60 60 60 60 60 60 60 60 60
				60 60 60 60 60 60 60 60 60 60 60 60 60 60 60 60 60 60
				60 60 60 60 60 60 60 60 60 60 60 60 60 60 60 60 60 60
				60 60 60 60 60 60 60 60 60 60 60 60 60 60 60 60 60 60
				60 60 60 60 60 60 60 60 60 60 60 60 60 60 60 60 60 60
				60 60 60 60 60 60 60 60 60 60 60 60 60 60 60 60 60 60
				>;

			PS_Config_Lmt_LPWG_Diff_N = <
				(-65535) (-60) (-60) (-60) (-60) (-60) (-60) (-60) (-65535) (-65535) (-60) (-60) (-60) (-60) (-60) (-60) (-60) (-65535)
				(-60) (-60) (-60) (-60) (-60) (-60)    (-60)    (-60)    (-60)    (-60)    (-60)    (-60) (-60) (-60) (-60) (-60) (-60) (-60)
				(-60) (-60) (-60) (-60) (-60) (-60)    (-60)    (-60)    (-60)    (-60)    (-60)    (-60) (-60) (-60) (-60) (-60) (-60) (-60)
				(-60) (-60) (-60) (-60) (-60) (-60)    (-60)    (-60)    (-60)    (-60)    (-60)    (-60) (-60) (-60) (-60) (-60) (-60) (-60)
				(-60) (-60) (-60) (-60) (-60) (-60)    (-60)    (-60)    (-60)    (-60)    (-60)    (-60) (-60) (-60) (-60) (-60) (-60) (-60)
				(-60) (-60) (-60) (-60) (-60) (-60)    (-60)    (-60)    (-60)    (-60)    (-60)    (-60) (-60) (-60) (-60) (-60) (-60) (-60)
				(-60) (-60) (-60) (-60) (-60) (-60)    (-60)    (-60)    (-60)    (-60)    (-60)    (-60) (-60) (-60) (-60) (-60) (-60) (-60)
				(-60) (-60) (-60) (-60) (-60) (-60)    (-60)    (-60)    (-60)    (-60)    (-60)    (-60) (-60) (-60) (-60) (-60) (-60) (-60)
				(-60) (-60) (-60) (-60) (-60) (-60)    (-60)    (-60)    (-60)    (-60)    (-60)    (-60) (-60) (-60) (-60) (-60) (-60) (-60)
				(-60) (-60) (-60) (-60) (-60) (-60)    (-60)    (-60)    (-60)    (-60)    (-60)    (-60) (-60) (-60) (-60) (-60) (-60) (-60)
				(-60) (-60) (-60) (-60) (-60) (-60)    (-60)    (-60)    (-60)    (-60)    (-60)    (-60) (-60) (-60) (-60) (-60) (-60) (-60)
				(-60) (-60) (-60) (-60) (-60) (-60)    (-60)    (-60)    (-60)    (-60)    (-60)    (-60) (-60) (-60) (-60) (-60) (-60) (-60)
				(-60) (-60) (-60) (-60) (-60) (-60)    (-60)    (-60)    (-60)    (-60)    (-60)    (-60) (-60) (-60) (-60) (-60) (-60) (-60)
				(-60) (-60) (-60) (-60) (-60) (-60)    (-60)    (-60)    (-60)    (-60)    (-60)    (-60) (-60) (-60) (-60) (-60) (-60) (-60)
				(-60) (-60) (-60) (-60) (-60) (-60)    (-60)    (-60)    (-60)    (-60)    (-60)    (-60) (-60) (-60) (-60) (-60) (-60) (-60)
				(-60) (-60) (-60) (-60) (-60) (-60)    (-60)    (-60)    (-60)    (-60)    (-60)    (-60) (-60) (-60) (-60) (-60) (-60) (-60)
				(-60) (-60) (-60) (-60) (-60) (-60)    (-60)    (-60)    (-60)    (-60)    (-60)    (-60) (-60) (-60) (-60) (-60) (-60) (-60)
				(-60) (-60) (-60) (-60) (-60) (-60)    (-60)    (-60)    (-60)    (-60)    (-60)    (-60) (-60) (-60) (-60) (-60) (-60) (-60)
				(-60) (-60) (-60) (-60) (-60) (-60)    (-60)    (-60)    (-60)    (-60)    (-60)    (-60) (-60) (-60) (-60) (-60) (-60) (-60)
				(-60) (-60) (-60) (-60) (-60) (-60)    (-60)    (-60)    (-60)    (-60)    (-60)    (-60) (-60) (-60) (-60) (-60) (-60) (-60)
				(-60) (-60) (-60) (-60) (-60) (-60)    (-60)    (-60)    (-60)    (-60)    (-60)    (-60) (-60) (-60) (-60) (-60) (-60) (-60)
				(-60) (-60) (-60) (-60) (-60) (-60)    (-60)    (-60)    (-60)    (-60)    (-60)    (-60) (-60) (-60) (-60) (-60) (-60) (-60)
				(-60) (-60) (-60) (-60) (-60) (-60)    (-60)    (-60)    (-60)    (-60)    (-60)    (-60) (-60) (-60) (-60) (-60) (-60) (-60)
				(-60) (-60) (-60) (-60) (-60) (-60)    (-60)    (-60)    (-60)    (-60)    (-60)    (-60) (-60) (-60) (-60) (-60) (-60) (-60)
				(-60) (-60) (-60) (-60) (-60) (-60)    (-60)    (-60)    (-60)    (-60)    (-60)    (-60) (-60) (-60) (-60) (-60) (-60) (-60)
				(-60) (-60) (-60) (-60) (-60) (-60)    (-60)    (-60)    (-60)    (-60)    (-60)    (-60) (-60) (-60) (-60) (-60) (-60) (-60)
				(-60) (-60) (-60) (-60) (-60) (-60)    (-60)    (-60)    (-60)    (-60)    (-60)    (-60) (-60) (-60) (-60) (-60) (-60) (-60)
				(-60) (-60) (-60) (-60) (-60) (-60)    (-60)    (-60)    (-60)    (-60)    (-60)    (-60) (-60) (-60) (-60) (-60) (-60) (-60)
				(-60) (-60) (-60) (-60) (-60) (-60)    (-60)    (-60)    (-60)    (-60)    (-60)    (-60) (-60) (-60) (-60) (-60) (-60) (-60)
				(-60) (-60) (-60) (-60) (-60) (-60)    (-60)    (-60)    (-60)    (-60)    (-60)    (-60) (-60) (-60) (-60) (-60) (-60) (-60)
				(-60) (-60) (-60) (-60) (-60) (-60)    (-60)    (-60)    (-60)    (-60)    (-60)    (-60) (-60) (-60) (-60) (-60) (-60) (-60)
				(-60) (-60) (-60) (-60) (-60) (-60)    (-60)    (-60)    (-60)    (-60)    (-60)    (-60) (-60) (-60) (-60) (-60) (-60) (-60)
				>;
		};
	};
};
